## nvidia/drivers/iio/proximity/ch201/Kconfig
```kconfig
config CH201
	tristate "tdk ch201 proximity"
	depends on I2C
	help
	  The driver uses the NVS (NVidia Sensor) IIO and proximity
	  framework.
```

## nvidia/drivers/iio/proximity/vl53l5cx/Kconfig
```kconfig
config VL53L5CX
	tristate "st vl53l5cx proximity"
	depends on I2C
	help
	  The driver uses the NVS (NVidia Sensor) IIO and proximity
	  framework.
```

## nvidia/drivers/iio/temperature/sht30/Kconfig
```kconfig
config SHT30
	tristate "sensirion sht30 temperature and humidity"
	depends on I2C
	help
	  The driver uses the NVS (NVidia Sensor) IIO and proximity
	  framework.
```
